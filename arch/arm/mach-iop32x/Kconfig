## arch/arm/mach-iop32x/Kconfig
```kconfig
if ARCH_IOP32X

menu "IOP32x Implementation Options"

comment "IOP32x Platform Types"

config MACH_EP80219
	bool

config MACH_GLANTANK
	bool "Enable support for the IO-Data GLAN Tank"
	help
	  Say Y here if you want to run your kernel on the GLAN Tank
	  NAS appliance or machines from IO-Data's HDL-Gxxx, HDL-GWxxx
	  and HDL-GZxxx series.

config ARCH_IQ80321
	bool "Enable support for IQ80321"
	select ARCH_IOP321
	help
	  Say Y here if you want to run your kernel on the Intel IQ80321
	  evaluation kit for the IOP321 processor.

config ARCH_IQ31244
	bool "Enable support for EP80219/IQ31244"
	select MACH_EP80219
	help
	  Say Y here if you want to run your kernel on the Intel EP80219
	  evaluation kit for the Intel 80219 processor (a IOP321 variant)
	  or the IQ31244 evaluation kit for the IOP321 processor.

config MACH_N2100
	bool "Enable support for the Thecus n2100"
	help
	  Say Y here if you want to run your kernel on the Thecus n2100
	  NAS appliance.

# should have been a MACH
config ARCH_ACQ200
	bool "Enable support for ACQ200"
	select ARCH_ACQX00
	help
	  Say Y here to run kernel on the D-TACQ ACQ200 intelligent
	  data acquisition blades. (use IOP321) www.d-tacq.com

config MACH_ACQ100
	bool "Enable support for ACQ100"
	select ARCH_ACQX00
	help
	  Say Y here to run kernel on the D-TACQ ACQ100 intelligent
	  data acquisition blades. (use IOP321) www.d-tacq.com
	
config ARCH_ACQX00
	bool
	depends on ARCH_ACQ200	|| MACH_ACQ100
	default y
	select ARCH_IOP321
	select FIQ
	select LEDS
	select LEDS_TIMER
	select LEDS_CPU
	select MTD_ACQ200

config ARCH_IOP321
	bool
	default y
	depends on ARCH_ACQX00
	help
	  Hidden option
config IOP3XX_ATU
        bool "Enable the PCI Controller"
        default y
        help
          Say Y here if you want the IOP to initialize its PCI Controller.
          Say N if the IOP is an add in card, the host system owns the PCI
          bus in this case.

endmenu

endif
```
